base {
    display-name = "LeftPad";
    bindings = <
        &kp F1   &kp F2   &kp F3   &kp F4   &kp F5   &kp F6    &none &none &none &none &none &none
        &kp C_PREV &kp C_PP &kp C_NEXT &kp VOL_DN &kp VOL_UP &kp MUTE  &none &none &none &none &none &none
        &kp LCTRL &kp LSFT &kp LALT &kp LGUI &kp TAB &kp ESC   &none &none &none &none &none &none
        &mo 1 &kp SPACE &kp ENTER &kp BSPC &kp DEL &to 0       &none &none &none &none &none &none
    >;
};
