## config/boards/shields/Sync24/Kconfig.defconfig
```kconfig
# Copyright (c) 2025 The ZMK Contributors
# SPDX-License-Identifier: MIT

if SHIELD_SYNC24_LEFT
config ZMK_KEYBOARD_NAME
    default "SYNC24L"
endif

if SHIELD_SYNC24_RIGHT
config ZMK_KEYBOARD_NAME
    default "SYNC24R"
endif

if SHIELD_SYNC24_LEFT || SHIELD_SYNC24_RIGHT
config ZMK_STUDIO
    default y
endif
```
